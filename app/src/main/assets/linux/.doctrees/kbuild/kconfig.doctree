## app/src/main/assets/linux/kbuild/kconfig.html
```kconfig
<!DOCTYPE html>

<html lang="en">
  <head>
    <meta charset="utf-8" />
    <meta name="viewport" content="width=device-width, initial-scale=1.0" /><meta name="generator" content="Docutils 0.19: https://docutils.sourceforge.io/" />

    <title>Kconfig make config &#8212; The Linux Kernel  documentation</title>
    <link rel="stylesheet" type="text/css" href="../_static/pygments.css" />
    <link rel="stylesheet" type="text/css" href="../_static/alabaster.css" />
    <script data-url_root="../" id="documentation_options" src="../_static/documentation_options.js"></script>
    <script src="../_static/jquery.js"></script>
    <script src="../_static/underscore.js"></script>
    <script src="../_static/_sphinx_javascript_frameworks_compat.js"></script>
    <script src="../_static/doctools.js"></script>
    <script src="../_static/sphinx_highlight.js"></script>
    <link rel="index" title="Index" href="../genindex.html" />
    <link rel="search" title="Search" href="../search.html" />
    <link rel="next" title="Linux Kernel Makefiles" href="makefiles.html" />
    <link rel="prev" title="Kbuild" href="kbuild.html" />
   
  <link rel="stylesheet" href="../_static/custom.css" type="text/css" />
  
  
  <meta name="viewport" content="width=device-width, initial-scale=0.9, maximum-scale=0.9" />

  </head><body>
  <div class="document">
    
      <div class="sphinxsidebar" role="navigation" aria-label="main navigation">
        <div class="sphinxsidebarwrapper">
<h1 class="logo"><a href="../index.html">The Linux Kernel</a></h1>



<p class="blurb">6.7.0</p>







<div id="searchbox" style="display: none" role="search">
  <h3 id="searchlabel">Quick search</h3>
    <div class="searchformwrapper">
    <form class="search" action="../search.html" method="get">
      <input type="text" name="q" aria-labelledby="searchlabel" autocomplete="off" autocorrect="off" autocapitalize="off" spellcheck="false"/>
      <input type="submit" value="Go" />
    </form>
    </div>
</div>
<script>document.getElementById('searchbox').style.display = "block"</script><!-- SPDX-License-Identifier: GPL-2.0 -->

<p>
<h3 class="kernel-toc-contents">Contents</h3>
<input type="checkbox" class="kernel-toc-toggle" id = "kernel-toc-toggle" checked>
<label class="kernel-toc-title" for="kernel-toc-toggle"></label>

<div class="kerneltoc" id="kerneltoc">
<ul>
<li class="toctree-l1"><a class="reference internal" href="../process/development-process.html">A guide to the Kernel Development Process</a></li>
<li class="toctree-l1"><a class="reference internal" href="../process/submitting-patches.html">Submitting patches: the essential guide to getting your code into the kernel</a></li>
<li class="toctree-l1"><a class="reference internal" href="../process/code-of-conduct.html">Code of conduct</a></li>
<li class="toctree-l1"><a class="reference internal" href="../maintainer/index.html">Kernel Maintainer Handbook</a></li>
<li class="toctree-l1"><a class="reference internal" href="../process/index.html">All development-process docs</a></li>
</ul>
<ul>
<li class="toctree-l1"><a class="reference internal" href="../core-api/index.html">Core API Documentation</a></li>
<li class="toctree-l1"><a class="reference internal" href="../driver-api/index.html">Driver implementer's API guide</a></li>
<li class="toctree-l1"><a class="reference internal" href="../subsystem-apis.html">Kernel subsystem documentation</a></li>
<li class="toctree-l1"><a class="reference internal" href="../locking/index.html">Locking in the kernel</a></li>
</ul>
<ul>
<li class="toctree-l1"><a class="reference internal" href="../process/license-rules.html">Linux kernel licensing rules</a></li>
<li class="toctree-l1"><a class="reference internal" href="../doc-guide/index.html">How to write kernel documentation</a></li>
<li class="toctree-l1"><a class="reference internal" href="../dev-tools/index.html">Development tools for the kernel</a></li>
<li class="toctree-l1"><a class="reference internal" href="../dev-tools/testing-overview.html">Kernel Testing Guide</a></li>
<li class="toctree-l1"><a class="reference internal" href="../kernel-hacking/index.html">Kernel Hacking Guides</a></li>
<li class="toctree-l1"><a class="reference internal" href="../trace/index.html">Linux Tracing Technologies</a></li>
<li class="toctree-l1"><a class="reference internal" href="../fault-injection/index.html">fault-injection</a></li>
<li class="toctree-l1"><a class="reference internal" href="../livepatch/index.html">Kernel Livepatching</a></li>
<li class="toctree-l1"><a class="reference internal" href="../rust/index.html">Rust</a></li>
</ul>
<ul class="current">
<li class="toctree-l1"><a class="reference internal" href="../admin-guide/index.html">The Linux kernel user's and administrator's guide</a></li>
<li class="toctree-l1 current"><a class="reference internal" href="index.html">The kernel build system</a><ul class="current">
<li class="toctree-l2"><a class="reference internal" href="kconfig-language.html">Kconfig Language</a></li>
<li class="toctree-l2"><a class="reference internal" href="kconfig-macro-language.html">Kconfig macro language</a></li>
<li class="toctree-l2"><a class="reference internal" href="kbuild.html">Kbuild</a></li>
<li class="toctree-l2 current"><a class="current reference internal" href="#">Kconfig make config</a><ul>
<li class="toctree-l3"><a class="reference internal" href="#general">General</a></li>
<li class="toctree-l3"><a class="reference internal" href="#kconfig-config">KCONFIG_CONFIG</a></li>
<li class="toctree-l3"><a class="reference internal" href="#kconfig-defconfig-list">KCONFIG_DEFCONFIG_LIST</a></li>
<li class="toctree-l3"><a class="reference internal" href="#kconfig-overwriteconfig">KCONFIG_OVERWRITECONFIG</a></li>
<li class="toctree-l3"><a class="reference internal" href="#kconfig-warn-unknown-symbols">KCONFIG_WARN_UNKNOWN_SYMBOLS</a></li>
<li class="toctree-l3"><a class="reference internal" href="#kconfig-werror">KCONFIG_WERROR</a></li>
<li class="toctree-l3"><a class="reference internal" href="#config"><cite>CONFIG_</cite></a></li>
<li class="toctree-l3"><a class="reference internal" href="#kconfig-allconfig">KCONFIG_ALLCONFIG</a></li>
<li class="toctree-l3"><a class="reference internal" href="#kconfig-seed">KCONFIG_SEED</a></li>
<li class="toctree-l3"><a class="reference internal" href="#kconfig-probability">KCONFIG_PROBABILITY</a></li>
<li class="toctree-l3"><a class="reference internal" href="#kconfig-nosilentupdate">KCONFIG_NOSILENTUPDATE</a></li>
<li class="toctree-l3"><a class="reference internal" href="#kconfig-autoconfig">KCONFIG_AUTOCONFIG</a></li>
<li class="toctree-l3"><a class="reference internal" href="#kconfig-autoheader">KCONFIG_AUTOHEADER</a></li>
<li class="toctree-l3"><a class="reference internal" href="#menuconfig">menuconfig</a></li>
<li class="toctree-l3"><a class="reference internal" href="#menuconfig-color">MENUCONFIG_COLOR</a></li>
<li class="toctree-l3"><a class="reference internal" href="#menuconfig-mode">MENUCONFIG_MODE</a></li>
<li class="toctree-l3"><a class="reference internal" href="#nconfig">nconfig</a></li>
<li class="toctree-l3"><a class="reference internal" href="#nconfig-mode">NCONFIG_MODE</a></li>
<li class="toctree-l3"><a class="reference internal" href="#xconfig">xconfig</a></li>
<li class="toctree-l3"><a class="reference internal" href="#gconfig">gconfig</a></li>
</ul>
</li>
<li class="toctree-l2"><a class="reference internal" href="makefiles.html">Linux Kernel Makefiles</a></li>
<li class="toctree-l2"><a class="reference internal" href="modules.html">Building External Modules</a></li>
<li class="toctree-l2"><a class="reference internal" href="headers_install.html">Exporting kernel headers for use by userspace</a></li>
<li class="toctree-l2"><a class="reference internal" href="issues.html">Recursion issues</a></li>
<li class="toctree-l2"><a class="reference internal" href="reproducible-builds.html">Reproducible builds</a></li>
<li class="toctree-l2"><a class="reference internal" href="gcc-plugins.html">GCC plugin infrastructure</a></li>
<li class="toctree-l2"><a class="reference internal" href="llvm.html">Building Linux with Clang/LLVM</a></li>
</ul>
</li>
<li class="toctree-l1"><a class="reference internal" href="../admin-guide/reporting-issues.html">Reporting issues</a></li>
<li class="toctree-l1"><a class="reference internal" href="../tools/index.html">User-space tools</a></li>
<li class="toctree-l1"><a class="reference internal" href="../userspace-api/index.html">The Linux kernel user-space API guide</a></li>
</ul>
<ul>
<li class="toctree-l1"><a class="reference internal" href="../firmware-guide/index.html">The Linux kernel firmware guide</a></li>
<li class="toctree-l1"><a class="reference internal" href="../devicetree/index.html">Open Firmware and Devicetree</a></li>
</ul>
<ul>
<li class="toctree-l1"><a class="reference internal" href="../arch/index.html">CPU Architectures</a></li>
</ul>
<ul>
<li class="toctree-l1"><a class="reference internal" href="../staging/index.html">Unsorted Documentation</a></li>
</ul>
<ul>
<li class="toctree-l1"><a class="reference internal" href="../translations/index.html">Translations</a></li>
</ul>

</div>

<script type="text/javascript"> <!--
  var sbar = document.getElementsByClassName("sphinxsidebar")[0];
  let currents = document.getElementsByClassName("current")
  sbar.scrollTop = currents[currents.length - 1].offsetTop;
  --> </script>
  <div role="note" aria-label="source link">
    <h3>This Page</h3>
    <ul class="this-page-menu">
      <li><a href="../_sources/kbuild/kconfig.rst.txt"
            rel="nofollow">Show Source</a></li>
    </ul>
   </div>
        </div>
      </div>
      <div class="documentwrapper">
        <div class="bodywrapper">
          

          <div class="body" role="main">
            
  <section id="kconfig-make-config">
<h1>Kconfig make config<a class="headerlink" href="#kconfig-make-config" title="Permalink to this heading">¶</a></h1>
<p>This file contains some assistance for using <cite>make *config</cite>.</p>
<p>Use &quot;make help&quot; to list all of the possible configuration targets.</p>
<p>The xconfig ('qconf'), menuconfig ('mconf'), and nconfig ('nconf')
programs also have embedded help text.  Be sure to check that for
navigation, search, and other general help text.</p>
<p>The gconfig ('gconf') program has limited help text.</p>
<section id="general">
<h2>General<a class="headerlink" href="#general" title="Permalink to this heading">¶</a></h2>
<p>New kernel releases often introduce new config symbols.  Often more
important, new kernel releases may rename config symbols.  When
this happens, using a previously working .config file and running
&quot;make oldconfig&quot; won't necessarily produce a working new kernel
for you, so you may find that you need to see what NEW kernel
symbols have been introduced.</p>
<p>To see a list of new config symbols, use:</p>
<div class="highlight-none notranslate"><div class="highlight"><pre><span></span>cp user/some/old.config .config
make listnewconfig
</pre></div>
</div>
<p>and the config program will list any new symbols, one per line.</p>
<p>Alternatively, you can use the brute force method:</p>
<div class="highlight-none notranslate"><div class="highlight"><pre><span></span>make oldconfig
scripts/diffconfig .config.old .config | less
</pre></div>
</div>
<hr class="docutils" />
<p>Environment variables for <cite>*config</cite></p>
</section>
<section id="kconfig-config">
<h2>KCONFIG_CONFIG<a class="headerlink" href="#kconfig-config" title="Permalink to this heading">¶</a></h2>
<p>This environment variable can be used to specify a default kernel config
file name to override the default name of &quot;.config&quot;.</p>
</section>
<section id="kconfig-defconfig-list">
<h2>KCONFIG_DEFCONFIG_LIST<a class="headerlink" href="#kconfig-defconfig-list" title="Permalink to this heading">¶</a></h2>
<p>This environment variable specifies a list of config files which can be used
as a base configuration in case the .config does not exist yet. Entries in
the list are separated with whitespaces to each other, and the first one
that exists is used.</p>
</section>
<section id="kconfig-overwriteconfig">
<h2>KCONFIG_OVERWRITECONFIG<a class="headerlink" href="#kconfig-overwriteconfig" title="Permalink to this heading">¶</a></h2>
<p>If you set KCONFIG_OVERWRITECONFIG in the environment, Kconfig will not
break symlinks when .config is a symlink to somewhere else.</p>
</section>
<section id="kconfig-warn-unknown-symbols">
<h2>KCONFIG_WARN_UNKNOWN_SYMBOLS<a class="headerlink" href="#kconfig-warn-unknown-symbols" title="Permalink to this heading">¶</a></h2>
<p>This environment variable makes Kconfig warn about all unrecognized
symbols in the config input.</p>
</section>
<section id="kconfig-werror">
<h2>KCONFIG_WERROR<a class="headerlink" href="#kconfig-werror" title="Permalink to this heading">¶</a></h2>
<p>If set, Kconfig treats warnings as errors.</p>
</section>
<section id="config">
<h2><cite>CONFIG_</cite><a class="headerlink" href="#config" title="Permalink to this heading">¶</a></h2>
<p>If you set <cite>CONFIG_</cite> in the environment, Kconfig will prefix all symbols
with its value when saving the configuration, instead of using the default,
<cite>CONFIG_</cite>.</p>
<hr class="docutils" />
<p>Environment variables for '{allyes/allmod/allno/rand}config'</p>
</section>
<section id="kconfig-allconfig">
<h2>KCONFIG_ALLCONFIG<a class="headerlink" href="#kconfig-allconfig" title="Permalink to this heading">¶</a></h2>
<p>(partially based on lkml email from/by Rob Landley, re: miniconfig)</p>
<hr class="docutils" />
<p>The allyesconfig/allmodconfig/allnoconfig/randconfig variants can also
use the environment variable KCONFIG_ALLCONFIG as a flag or a filename
that contains config symbols that the user requires to be set to a
specific value.  If KCONFIG_ALLCONFIG is used without a filename where
KCONFIG_ALLCONFIG == &quot;&quot; or KCONFIG_ALLCONFIG == &quot;1&quot;, <cite>make *config</cite>
checks for a file named &quot;all{yes/mod/no/def/random}.config&quot;
(corresponding to the <cite>*config</cite> command that was used) for symbol values
that are to be forced.  If this file is not found, it checks for a
file named &quot;all.config&quot; to contain forced values.</p>
<p>This enables you to create &quot;miniature&quot; config (miniconfig) or custom
config files containing just the config symbols that you are interested
in.  Then the kernel config system generates the full .config file,
including symbols of your miniconfig file.</p>
<p>This 'KCONFIG_ALLCONFIG' file is a config file which contains
(usually a subset of all) preset config symbols.  These variable
settings are still subject to normal dependency checks.</p>
<p>Examples:</p>
<div class="highlight-none notranslate"><div class="highlight"><pre><span></span>KCONFIG_ALLCONFIG=custom-notebook.config make allnoconfig
</pre></div>
</div>
<p>or:</p>
<div class="highlight-none notranslate"><div class="highlight"><pre><span></span>KCONFIG_ALLCONFIG=mini.config make allnoconfig
</pre></div>
</div>
<p>or:</p>
<div class="highlight-none notranslate"><div class="highlight"><pre><span></span>make KCONFIG_ALLCONFIG=mini.config allnoconfig
</pre></div>
</div>
<p>These examples will disable most options (allnoconfig) but enable or
disable the options that are explicitly listed in the specified
mini-config files.</p>
<hr class="docutils" />
<p>Environment variables for 'randconfig'</p>
</section>
<section id="kconfig-seed">
<h2>KCONFIG_SEED<a class="headerlink" href="#kconfig-seed" title="Permalink to this heading">¶</a></h2>
<p>You can set this to the integer value used to seed the RNG, if you want
to somehow debug the behaviour of the kconfig parser/frontends.
If not set, the current time will be used.</p>
</section>
<section id="kconfig-probability">
<h2>KCONFIG_PROBABILITY<a class="headerlink" href="#kconfig-probability" title="Permalink to this heading">¶</a></h2>
<p>This variable can be used to skew the probabilities. This variable can
be unset or empty, or set to three different formats:</p>
<blockquote>
<div><table class="docutils align-default">
<thead>
<tr class="row-odd"><th class="head"><p>KCONFIG_PROBABILITY</p></th>
<th class="head"><p>y:n split</p></th>
<th class="head"><p>y:m:n split</p></th>
</tr>
</thead>
<tbody>
<tr class="row-even"><td><p>unset or empty</p></td>
<td><p>50  : 50</p></td>
<td><p>33  : 33  : 34</p></td>
</tr>
<tr class="row-odd"><td><p>N</p></td>
<td><p>N  : 100-N</p></td>
<td><p>N/2 : N/2 : 100-N</p></td>
</tr>
<tr class="row-even"><td><p>[1] N:M</p></td>
<td><p>N+M : 100-(N+M)</p></td>
<td><p>N  :  M  : 100-(N+M)</p></td>
</tr>
<tr class="row-odd"><td><p>[2] N:M:L</p></td>
<td><p>N  : 100-N</p></td>
<td><p>M  :  L  : 100-(M+L)</p></td>
</tr>
</tbody>
</table>
</div></blockquote>
<p>where N, M and L are integers (in base 10) in the range [0,100], and so
that:</p>
<blockquote>
<div><p>[1] N+M is in the range [0,100]</p>
<p>[2] M+L is in the range [0,100]</p>
</div></blockquote>
<p>Examples:</p>
<div class="highlight-none notranslate"><div class="highlight"><pre><span></span>KCONFIG_PROBABILITY=10
        10% of booleans will be set to &#39;y&#39;, 90% to &#39;n&#39;
        5% of tristates will be set to &#39;y&#39;, 5% to &#39;m&#39;, 90% to &#39;n&#39;
KCONFIG_PROBABILITY=15:25
        40% of booleans will be set to &#39;y&#39;, 60% to &#39;n&#39;
        15% of tristates will be set to &#39;y&#39;, 25% to &#39;m&#39;, 60% to &#39;n&#39;
KCONFIG_PROBABILITY=10:15:15
        10% of booleans will be set to &#39;y&#39;, 90% to &#39;n&#39;
        15% of tristates will be set to &#39;y&#39;, 15% to &#39;m&#39;, 70% to &#39;n&#39;
</pre></div>
</div>
<hr class="docutils" />
<p>Environment variables for 'syncconfig'</p>
</section>
<section id="kconfig-nosilentupdate">
<h2>KCONFIG_NOSILENTUPDATE<a class="headerlink" href="#kconfig-nosilentupdate" title="Permalink to this heading">¶</a></h2>
<p>If this variable has a non-blank value, it prevents silent kernel
config updates (requires explicit updates).</p>
</section>
<section id="kconfig-autoconfig">
<h2>KCONFIG_AUTOCONFIG<a class="headerlink" href="#kconfig-autoconfig" title="Permalink to this heading">¶</a></h2>
<p>This environment variable can be set to specify the path &amp; name of the
&quot;auto.conf&quot; file.  Its default value is &quot;include/config/auto.conf&quot;.</p>
</section>
<section id="kconfig-autoheader">
<h2>KCONFIG_AUTOHEADER<a class="headerlink" href="#kconfig-autoheader" title="Permalink to this heading">¶</a></h2>
<p>This environment variable can be set to specify the path &amp; name of the
&quot;autoconf.h&quot; (header) file.
Its default value is &quot;include/generated/autoconf.h&quot;.</p>
</section>
<hr class="docutils" />
<section id="menuconfig">
<h2>menuconfig<a class="headerlink" href="#menuconfig" title="Permalink to this heading">¶</a></h2>
<p>SEARCHING for CONFIG symbols</p>
<p>Searching in menuconfig:</p>
<blockquote>
<div><p>The Search function searches for kernel configuration symbol
names, so you have to know something close to what you are
looking for.</p>
<p>Example:</p>
<div class="highlight-none notranslate"><div class="highlight"><pre><span></span>/hotplug
This lists all config symbols that contain &quot;hotplug&quot;,
e.g., HOTPLUG_CPU, MEMORY_HOTPLUG.
</pre></div>
</div>
<p>For search help, enter / followed by TAB-TAB (to highlight
&lt;Help&gt;) and Enter.  This will tell you that you can also use
regular expressions (regexes) in the search string, so if you
are not interested in MEMORY_HOTPLUG, you could try:</p>
<div class="highlight-none notranslate"><div class="highlight"><pre><span></span>/^hotplug
</pre></div>
</div>
<p>When searching, symbols are sorted thus:</p>
<blockquote>
<div><ul class="simple">
<li><p>first, exact matches, sorted alphabetically (an exact match
is when the search matches the complete symbol name);</p></li>
<li><p>then, other matches, sorted alphabetically.</p></li>
</ul>
</div></blockquote>
<p>For example: ^ATH.K matches:</p>
<blockquote>
<div><p>ATH5K ATH9K ATH5K_AHB ATH5K_DEBUG [...] ATH6KL ATH6KL_DEBUG
[...] ATH9K_AHB ATH9K_BTCOEX_SUPPORT ATH9K_COMMON [...]</p>
</div></blockquote>
<p>of which only ATH5K and ATH9K match exactly and so are sorted
first (and in alphabetical order), then come all other symbols,
sorted in alphabetical order.</p>
<p>In this menu, pressing the key in the (#) prefix will jump
directly to that location. You will be returned to the current
search results after exiting this new menu.</p>
</div></blockquote>
<hr class="docutils" />
<p>User interface options for 'menuconfig'</p>
</section>
<section id="menuconfig-color">
<h2>MENUCONFIG_COLOR<a class="headerlink" href="#menuconfig-color" title="Permalink to this heading">¶</a></h2>
<p>It is possible to select different color themes using the variable
MENUCONFIG_COLOR.  To select a theme use:</p>
<div class="highlight-none notranslate"><div class="highlight"><pre><span></span>make MENUCONFIG_COLOR=&lt;theme&gt; menuconfig
</pre></div>
</div>
<p>Available themes are:</p>
<div class="highlight-none notranslate"><div class="highlight"><pre><span></span>- mono       =&gt; selects colors suitable for monochrome displays
- blackbg    =&gt; selects a color scheme with black background
- classic    =&gt; theme with blue background. The classic look
- bluetitle  =&gt; a LCD friendly version of classic. (default)
</pre></div>
</div>
</section>
<section id="menuconfig-mode">
<h2>MENUCONFIG_MODE<a class="headerlink" href="#menuconfig-mode" title="Permalink to this heading">¶</a></h2>
<p>This mode shows all sub-menus in one large tree.</p>
<p>Example:</p>
<div class="highlight-none notranslate"><div class="highlight"><pre><span></span>make MENUCONFIG_MODE=single_menu menuconfig
</pre></div>
</div>
</section>
<hr class="docutils" />
<section id="nconfig">
<h2>nconfig<a class="headerlink" href="#nconfig" title="Permalink to this heading">¶</a></h2>
<p>nconfig is an alternate text-based configurator.  It lists function
keys across the bottom of the terminal (window) that execute commands.
You can also just use the corresponding numeric key to execute the
commands unless you are in a data entry window.  E.g., instead of F6
for Save, you can just press 6.</p>
<p>Use F1 for Global help or F3 for the Short help menu.</p>
<p>Searching in nconfig:</p>
<blockquote>
<div><p>You can search either in the menu entry &quot;prompt&quot; strings
or in the configuration symbols.</p>
<p>Use / to begin a search through the menu entries.  This does
not support regular expressions.  Use &lt;Down&gt; or &lt;Up&gt; for
Next hit and Previous hit, respectively.  Use &lt;Esc&gt; to
terminate the search mode.</p>
<p>F8 (SymSearch) searches the configuration symbols for the
given string or regular expression (regex).</p>
<p>In the SymSearch, pressing the key in the (#) prefix will
jump directly to that location. You will be returned to the
current search results after exiting this new menu.</p>
</div></blockquote>
</section>
<section id="nconfig-mode">
<h2>NCONFIG_MODE<a class="headerlink" href="#nconfig-mode" title="Permalink to this heading">¶</a></h2>
<p>This mode shows all sub-menus in one large tree.</p>
<p>Example:</p>
<div class="highlight-none notranslate"><div class="highlight"><pre><span></span>make NCONFIG_MODE=single_menu nconfig
</pre></div>
</div>
</section>
<hr class="docutils" />
<section id="xconfig">
<h2>xconfig<a class="headerlink" href="#xconfig" title="Permalink to this heading">¶</a></h2>
<p>Searching in xconfig:</p>
<blockquote>
<div><p>The Search function searches for kernel configuration symbol
names, so you have to know something close to what you are
looking for.</p>
<p>Example:</p>
<div class="highlight-none notranslate"><div class="highlight"><pre><span></span>Ctrl-F hotplug
</pre></div>
</div>
<p>or:</p>
<div class="highlight-none notranslate"><div class="highlight"><pre><span></span>Menu: File, Search, hotplug
</pre></div>
</div>
<p>lists all config symbol entries that contain &quot;hotplug&quot; in
the symbol name.  In this Search dialog, you may change the
config setting for any of the entries that are not grayed out.
You can also enter a different search string without having
to return to the main menu.</p>
</div></blockquote>
</section>
<hr class="docutils" />
<section id="gconfig">
<h2>gconfig<a class="headerlink" href="#gconfig" title="Permalink to this heading">¶</a></h2>
<p>Searching in gconfig:</p>
<blockquote>
<div><p>There is no search command in gconfig.  However, gconfig does
have several different viewing choices, modes, and options.</p>
</div></blockquote>
</section>
</section>


          </div>
          
        </div>
      </div>
    <div class="clearer"></div>
  </div>
    <div class="footer">
      &copy;The kernel development community.
      
      |
      Powered by <a href="http://sphinx-doc.org/">Sphinx 5.3.0</a>
      &amp; <a href="https://github.com/bitprophet/alabaster">Alabaster 0.7.12</a>
      
      |
      <a href="../_sources/kbuild/kconfig.rst.txt"
          rel="nofollow">Page source</a>
    </div>

    

    
  </body>
</html>
```
